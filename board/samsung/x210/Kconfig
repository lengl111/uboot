## board/samsung/x210/Kconfig
```kconfig
if TARGET_S5P_X210

config SYS_BOARD
	default "x210"

config SYS_VENDOR
	default "samsung"

config SYS_SOC
	default "s5pc1xx"

config SYS_CONFIG_NAME
	default "s5p_x210"

endif
```

## configs/s5p_x210_defconfig
```kconfig
CONFIG_ARM=y
CONFIG_ARCH_S5PC1XX=y
CONFIG_TARGET_S5P_X210=y
CONFIG_DEFAULT_DEVICE_TREE="s5pv210-x210"
```
